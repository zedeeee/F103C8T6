# file: F103C8T6.ioc
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Mcu.Family=STM32F1
Mcu.Name=STM32F103C(8-B)Tx
Mcu.Package=LQFP48
NVIC.PriorityGroup=NVIC_PRIORITYGROUP_4
PA13.Mode=Serial_Wire
PA13.Signal=SYS_JTMS-SWDIO
PA14.Mode=Serial_Wire
PA14.Signal=SYS_JTCK-SWCLK
PC13-TAMPER-RTC.GPIO_Label=LED_SYS
PC13-TAMPER-RTC.GPIO_ModeDefaultOutputPP=GPIO_MODE_OUTPUT_OD
PC13-TAMPER-RTC.GPIO_PuPd=GPIO_NOPULL
PC13-TAMPER-RTC.Signal=GPIO_Output
ProjectManager.HeapSize=0x200
ProjectManager.StackSize=0x400
ProjectManager.TargetToolchain=CMake
RCC.APB1Freq_Value=8000000
RCC.APB2Freq_Value=8000000
board=custom

// file: Core/Src/main.c
/* USER CODE BEGIN Header */
/**
  ******************************************************************************
  * @file           : main.c
  * @brief          : Main program body
  ******************************************************************************
  * @attention
  *
  * Copyright (c) 2025 STMicroelectronics.
  * All rights reserved.
  *
  * This software is licensed under terms that can be found in the LICENSE file
  * in the root directory of this software component.
  * If no LICENSE file comes with this software, it is provided AS-IS.
  *
  ******************************************************************************
  */
/* USER CODE END Header */
#include "main.h"

/* USER CODE BEGIN Includes */
#include <stdlib.h>
#include "led.h"
/* USER CODE END Includes */

/* USER CODE BEGIN PD */
// --- 烛光效果参数定义 ---
// 这些宏定义取代了硬编码的“魔术数字”，方便统一配置和修改。

// 亮度的变化范围，决定了烛光“跳动”的幅度。
#define CANDLE_BRIGHTNESS_MIN     100 // 最小亮度，避免完全熄灭
#define CANDLE_BRIGHTNESS_MAX     255 // 最大亮度
#define CANDLE_INITIAL_BRIGHTNESS 150 // 初始亮度

// 亮度每次随机变化的范围中心点和幅度。
// 变化量 = (rand() % CANDLE_CHANGE_RANGE) - CANDLE_CHANGE_OFFSET
#define CANDLE_CHANGE_RANGE       11  // 例如: rand() % 11 -> [0, 10]
#define CANDLE_CHANGE_OFFSET      5   // 例如: [0, 10] - 5 -> [-5, 5]

// 每一帧（亮度更新）之间的随机延迟时间范围。
#define CANDLE_FRAME_DELAY_BASE   50  // 基础延迟 (ms)
#define CANDLE_FRAME_DELAY_RANGE  50  // 随机延迟范围 (ms)，总延迟 = base + rand() % range
/* USER CODE END PD */

TIM_HandleTypeDef htim2;

/* USER CODE BEGIN PV */
// --- 私有变量 ---
// 当前LED的亮度值，定义为静态变量以在函数调用之间保持其状态。
static int g_led_brightness = CANDLE_INITIAL_BRIGHTNESS;
/* USER CODE END PV */

void SystemClock_Config(void);
static void MX_GPIO_Init(void);
static void MX_TIM2_Init(void);

/* USER CODE BEGIN 0 */

/**
  * @brief   执行单步烛光效果的逻辑更新。
  * @details 该函数负责计算下一次的亮度，并通过调用LED驱动来更新显示。
  *          它包含了烛光效果的所有核心算法，但与硬件实现解耦。
  * @param   None
  * @retval  None
  */
static void candle_effect_update(void)
{
  // 1. 平滑随机游走：通过增加一个小的随机值来调整亮度
  int change = (rand() % CANDLE_CHANGE_RANGE) - CANDLE_CHANGE_OFFSET;
  g_led_brightness += change;

  // 2. 边界限制：将亮度值限制在一个舒适的范围内
  if (g_led_brightness < CANDLE_BRIGHTNESS_MIN)
  {
    g_led_brightness = CANDLE_BRIGHTNESS_MIN;
  }
  if (g_led_brightness > CANDLE_BRIGHTNESS_MAX)
  {
    g_led_brightness = CANDLE_BRIGHTNESS_MAX;
  }

  // 3. 调用驱动层接口设置亮度
  //    业务逻辑层不再关心LED是如何被点亮的（软件PWM或硬件PWM），只负责传递亮度值。
  led_set_brightness((uint8_t)g_led_brightness);

  // 4. 非均匀时间间隔：在下一次亮度更新前，随机等待一段时间
  HAL_Delay((rand() % CANDLE_FRAME_DELAY_RANGE) + CANDLE_FRAME_DELAY_BASE);
}

/* USER CODE END 0 */

int main(void)
{

  /* MCU Configuration--------------------------------------------------------*/

  /* Reset of all peripherals, Initializes the Flash interface and the Systick. */
  HAL_Init();

  /* Configure the system clock */
  SystemClock_Config();

  /* Initialize all configured peripherals */
  MX_GPIO_Init();
  // MX_TIM2_Init(); // 暂时不使用硬件PWM
  /* USER CODE BEGIN 2 */
  // 初始化LED驱动
  led_init();
  /* USER CODE END 2 */

  /* Infinite loop */
  /* USER CODE BEGIN WHILE */
  while (1)
  {
    // 主循环现在只负责调用业务逻辑函数，实现了初步的逻辑分离。
    candle_effect_update();
    /* USER CODE END WHILE */

  }
}

void SystemClock_Config(void)
{
  RCC_OscInitTypeDef RCC_OscInitStruct = {0};
  RCC_ClkInitTypeDef RCC_ClkInitStruct = {0};

  /** Initializes the RCC Oscillators according to the specified parameters
  * in the RCC_OscInitTypeDef structure.
  */
  RCC_OscInitStruct.OscillatorType = RCC_OSCILLATORTYPE_HSI;
  RCC_OscInitStruct.HSIState = RCC_HSI_ON;
  RCC_OscInitStruct.HSICalibrationValue = RCC_HSICALIBRATION_DEFAULT;
  RCC_OscInitStruct.PLL.PLLState = RCC_PLL_NONE;
  if (HAL_RCC_OscConfig(&RCC_OscInitStruct) != HAL_OK)
  {
    Error_Handler();
  }

  /** Initializes the CPU, AHB and APB buses clocks
  */
  RCC_ClkInitStruct.ClockType = RCC_CLOCKTYPE_HCLK|RCC_CLOCKTYPE_SYSCLK
                              |RCC_CLOCKTYPE_PCLK1|RCC_CLOCKTYPE_PCLK2;
  RCC_ClkInitStruct.SYSCLKSource = RCC_SYSCLKSOURCE_HSI;
  RCC_ClkInitStruct.AHBCLKDivider = RCC_SYSCLK_DIV1;
  RCC_ClkInitStruct.APB1CLKDivider = RCC_HCLK_DIV1;
  RCC_ClkInitStruct.APB2CLKDivider = RCC_HCLK_DIV1;

  if (HAL_RCC_ClockConfig(&RCC_ClkInitStruct, FLASH_LATENCY_0) != HAL_OK)
  {
    Error_Handler();
  }
}

static void MX_TIM2_Init(void)
{

  TIM_MasterConfigTypeDef sMasterConfig = {0};
  TIM_OC_InitTypeDef sConfigOC = {0};

  htim2.Instance = TIM2;
  htim2.Init.Prescaler = 0;
  htim2.Init.CounterMode = TIM_COUNTERMODE_UP;
  htim2.Init.Period = 65535;
  htim2.Init.ClockDivision = TIM_CLOCKDIVISION_DIV1;
  htim2.Init.AutoReloadPreload = TIM_AUTORELOAD_PRELOAD_DISABLE;
  if (HAL_TIM_PWM_Init(&htim2) != HAL_OK)
  {
    Error_Handler();
  }
  sMasterConfig.MasterOutputTrigger = TIM_TRGO_RESET;
  sMasterConfig.MasterSlaveMode = TIM_MASTERSLAVEMODE_DISABLE;
  if (HAL_TIMEx_MasterConfigSynchronization(&htim2, &sMasterConfig) != HAL_OK)
  {
    Error_Handler();
  }
  sConfigOC.OCMode = TIM_OCMODE_PWM1;
  sConfigOC.Pulse = 0;
  sConfigOC.OCPolarity = TIM_OCPOLARITY_HIGH;
  sConfigOC.OCFastMode = TIM_OCFAST_DISABLE;
  if (HAL_TIM_PWM_ConfigChannel(&htim2, &sConfigOC, TIM_CHANNEL_1) != HAL_OK)
  {
    Error_Handler();
  }
  HAL_TIM_MspPostInit(&htim2);

}

static void MX_GPIO_Init(void)
{

  /* GPIO Ports Clock Enable */
  __HAL_RCC_GPIOC_CLK_ENABLE();
  __HAL_RCC_GPIOA_CLK_ENABLE();

  /* USER CODE BEGIN MX_GPIO_Init_2 */
  // 所有GPIO的初始化现在由CubeMX自动生成的代码处理。
  // 用于PWM的引脚(如PA0)由HAL_TIM_MspPostInit()在MX_TIM2_Init()中配置。
  // 原有的PC13引脚配置不再需要。
  /* USER CODE END MX_GPIO_Init_2 */
}

void Error_Handler(void)
{
  __disable_irq();
  while (1)
  {
  }
}
